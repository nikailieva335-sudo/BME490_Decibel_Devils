## CMakeLists.txt
```
cmake_minimum_required(VERSION 3.20.0)

find_package(Zephyr REQUIRED HINTS $ENV{ZEPHYR_BASE})
project(Speech_Therapy_Prototype)

target_sources(app PRIVATE
        src/main.c
        src/ble_lib.c
)
```

## prj.conf
```kconfig
# GY-MAX4466 is an analog module, so we need to enable the ADC driver
CONFIG_ADC=y

# Console Output
CONFIG_CONSOLE=y
CONFIG_UART_CONSOLE=y
CONFIG_SERIAL=y
CONFIG_PRINTK=y

# Enable logging
CONFIG_LOG=y

# Floating points
CONFIG_FPU=y
CONFIG_CBPRINTF_FP_SUPPORT=y

# Bluetooth
CONFIG_BT=y
CONFIG_BT_PERIPHERAL=y
CONFIG_BT_DEVICE_NAME="Decibel_Devils"
CONFIG_MAIN_STACK_SIZE=2048
CONFIG_SYSTEM_WORKQUEUE_STACK_SIZE=2048
```

## boards/nrf52833dk_nrf52833.overlay
```dts
#include <zephyr/dt-bindings/adc/adc.h>

// GY-MAX4466 mapped to P0.02 (AIN0) on the nRF52833DK

/ {
	zephyr,user {
		io-channels = <&adc 0>;
	};
};

&adc {
	#address-cells = <1>;
	#size-cells = <0>;
	status = "okay";

	channel@0 {
		reg = <0>;
		zephyr,gain = "ADC_GAIN_1_6";
		zephyr,reference = "ADC_REF_INTERNAL";
		zephyr,acquisition-time = <ADC_ACQ_TIME(ADC_ACQ_TIME_MICROSECONDS, 10)>;
		zephyr,input-positive = <NRF_SAADC_AIN0>;
		zephyr,resolution = <12>;
	};
};
```

## src/main.c
```c
#include <zephyr/kernel.h>
#include <zephyr/drivers/adc.h>
#include <zephyr/logging/log.h>
#include <zephyr/sys/printk.h>
#include <math.h>
#include "ble_lib.h"


LOG_MODULE_REGISTER(mic_db, LOG_LEVEL_INF); // Register a logging module named "mic_db"

#define NUM_SAMPLES     1000   // Number of samples to read in one window
#define SAMPLE_DELAY_US 1   // Delay between samples in microseconds
#define CAL_WINDOWS     50    // Number of windows to read for calibration (~2 seconds at 256 samples/window and 100us/sample)

#define SEND_DATA_WINDOWS 5 // Number of windows to read before sending data over BLE

static struct adc_dt_spec adc_channel = ADC_DT_SPEC_GET(DT_PATH(zephyr_user));

static int16_t samples[NUM_SAMPLES]; 	// Raw ADC readings
static int16_t buf; 					// Buffer for ADC reading
static struct adc_sequence sequence = { // ADC sequence configuration
	.buffer = &buf,
	.buffer_size = sizeof(buf),
};


// Reads one window of samples into an array and returns 0 on success or a negative error code on failure.
static int read_window(void)
{
	for (int i = 0; i < NUM_SAMPLES; i++) {
		int err = adc_read(adc_channel.dev, &sequence);

		if (err < 0) {
			return err;
		}
		samples[i] = buf;
		k_usleep(SAMPLE_DELAY_US);
	}
	return 0;
}

// Calculates the RMS value of the samples in the current window. Returns the RMS value as a float.
static float window_rms(void)
{
	float mean = 0.0f;
	float sum_sq = 0.0f;

	for (int i = 0; i < NUM_SAMPLES; i++) {
		mean += samples[i];
	}
	mean /= NUM_SAMPLES;

	for (int i = 0; i < NUM_SAMPLES; i++) {
		float d = samples[i] - mean;

		sum_sq += d * d;
	}

	return sqrtf(sum_sq / NUM_SAMPLES);
}

// FREQUENCY MEASUREMENT (COUNTS PEAKS) 
// Counts positive local peaks in one window.
static int window_peak_count(void)
{
	float mean = 0.0f;
	float sum_sq = 0.0f;

	for (int i = 0; i < NUM_SAMPLES; i++) {
		mean += samples[i];
	}
	mean /= NUM_SAMPLES;

	for (int i = 0; i < NUM_SAMPLES; i++) {
		float deviation = samples[i] - mean;
		sum_sq += deviation * deviation;
	}

	float threshold = mean + 0.25f * sqrtf(sum_sq / NUM_SAMPLES);
	int peaks = 0;

	for (int i = 1; i < NUM_SAMPLES - 1; i++) {
		if (samples[i] > threshold &&
			samples[i] >= samples[i - 1] &&
			samples[i] > samples[i + 1]) {
			peaks++;
		}
	}

	return peaks;
}

// Converts the number of detected peaks to Hz using the nominal sample period.
static float window_frequency_hz(void)
{
	float window_seconds = (NUM_SAMPLES * SAMPLE_DELAY_US) / 1000000.0f;

	return window_peak_count() / window_seconds;
}

// Initializates ADC, calibrates and logs the sound level continuously in dB. Returns 0 on success or a negative error code on failure.

int main(void)
{
	int err;

	err = bluetooth_init(NULL);
	if (err) {
		LOG_ERR("Bluetooth initialization failed (%d)", err);
		return 0;
	}

	if (!adc_is_ready_dt(&adc_channel)) {
		LOG_ERR("ADC controller device %s not ready", adc_channel.dev->name);
		return 0;
	}

	err = adc_channel_setup_dt(&adc_channel);
	if (err < 0) {
		LOG_ERR("Could not setup channel #%d (%d)", 0, err);
		return 0;
	}

	err = adc_sequence_init_dt(&adc_channel, &sequence);
	if (err < 0) {
		LOG_ERR("Could not initialize sequence (%d)", err);
		return 0;
	}


	// Unit conversion from mV to relative dB
	int32_t full_scale_mv = 4095;

	adc_raw_to_millivolts_dt(&adc_channel, &full_scale_mv);
	float mv_per_step = full_scale_mv / 4095.0f;

	// Calibration
	LOG_INF("Calibrating - keep quiet for ~2 seconds...");
	k_msleep(500);

	float ref_sum = 0.0f;

	for (int w = 0; w < CAL_WINDOWS; w++) {
		err = read_window();
		if (err < 0) {
			LOG_ERR("Could not read during calibration (%d)", err);
			return 0;
		}
		ref_sum += window_rms();
	}

	float rms_ref = ref_sum / CAL_WINDOWS;

	if (rms_ref < 0.5f) {
		rms_ref = 0.5f;
	}

	LOG_INF("Reference Vrms: %.2f mV", (double)(rms_ref * mv_per_step));


	while (1) {
		float rms_sum = 0.0f;
		float frequency_sum = 0.0f;
		int good_windows = 0;

		for (int w = 0; w < SEND_DATA_WINDOWS; w++) {
			err = read_window();
			if (err < 0) {
				LOG_ERR("Could not read (%d)", err);
				bluetooth_set_errors(ERR_ADC_READ);
				continue;
			}
			rms_sum += window_rms();
			frequency_sum += window_frequency_hz();
			good_windows++;
		}

		if (good_windows == 0) {
			k_msleep(50);
			continue;
		}

		float rms = rms_sum / good_windows;
		float frequency_hz = frequency_sum / good_windows;

		if (rms < 0.01f) {
			rms = 0.01f;  /* log10(0) is undefined */
		}

		float db = 20.0f * log10f(rms / rms_ref);

		LOG_INF("Vrms: %6.2f mV   level: %5.1f dB   frequency: %5.0f Hz",
			(double)(rms * mv_per_step), (double)db, (double)frequency_hz);

		/* Round to the nearest tenth of a dB, e.g. 12.43 -> 124 */
		int32_t db10 = (int32_t)(db * 10.0f + (db >= 0.0f ? 0.5f : -0.5f));

		err = bluetooth_send_sound_level(db10, (int32_t)(frequency_hz + 0.5f));
		if (err) {
			LOG_WRN("BLE send failed (%d)", err);
		}
	}

	return 0;
}
```

## src/ble_lib.c
```c
// Credit: Code Skeleton taken from BME554 Class
#include "ble_lib.h"
#include <zephyr/logging/log.h>
#include <string.h>

LOG_MODULE_REGISTER(blelib, LOG_LEVEL_INF);
#define DEVICE_NAME CONFIG_BT_DEVICE_NAME
#define DEVICE_NAME_LEN (sizeof(DEVICE_NAME) - 1)
#define MAX_MSG_LEN 64

static struct sound_measurement sound_measurement;
static uint32_t error_flags;
static bool sound_notify_enabled;
static bool err_notify_enabled;

static struct bt_conn *current_conn;
static struct bt_remote_srv_cb remote_service_callbacks;
static struct k_work adv_work;

static const struct bt_data ad[] = {
	BT_DATA_BYTES(BT_DATA_FLAGS, (BT_LE_AD_GENERAL | BT_LE_AD_NO_BREDR)),
	BT_DATA(BT_DATA_NAME_COMPLETE, DEVICE_NAME, DEVICE_NAME_LEN),
};

static const struct bt_data sd[] = {
	BT_DATA_BYTES(BT_DATA_UUID128_ALL, BT_UUID_REMOTE_SERV_VAL),
};

static ssize_t read_sound_cb(struct bt_conn *conn, const struct bt_gatt_attr *attr,
			     void *buf, uint16_t len, uint16_t offset)
{
	return bt_gatt_attr_read(conn, attr, buf, len, offset,
				 &sound_measurement, sizeof(sound_measurement));
}

static ssize_t read_error_cb(struct bt_conn *conn, const struct bt_gatt_attr *attr,
			     void *buf, uint16_t len, uint16_t offset)
{
	return bt_gatt_attr_read(conn, attr, buf, len, offset,
				 &error_flags, sizeof(error_flags));
}

static ssize_t on_write(struct bt_conn *conn, const struct bt_gatt_attr *attr,
			const void *buf, uint16_t len, uint16_t offset, uint8_t flags)
{
	char text[MAX_MSG_LEN + 1];
	uint16_t copy_len = MIN(len, MAX_MSG_LEN);

	memcpy(text, buf, copy_len);
	text[copy_len] = '\0';
	LOG_INF("Message from phone: %s", text);

	if (remote_service_callbacks.data_rx) {
		remote_service_callbacks.data_rx(conn, buf, len);
	}

	return len;
}

/*
 * Called when the phone turns Sound level notifications on or off.
 *
 * Args:
 *     attr: The CCC attribute that changed.
 *     value: BT_GATT_CCC_NOTIFY if enabled, 0 if disabled.
 */
static void sound_ccc_changed(const struct bt_gatt_attr *attr, uint16_t value)
{
	sound_notify_enabled = (value == BT_GATT_CCC_NOTIFY);
	LOG_INF("Sound level notifications %s",
		sound_notify_enabled ? "enabled" : "disabled");

	if (remote_service_callbacks.notif_changed) {
		remote_service_callbacks.notif_changed(sound_notify_enabled ?
			BT_DATA_NOTIFICATIONS_ENABLED : BT_DATA_NOTIFICATIONS_DISABLED);
	}
}

/*
 * Called when the phone turns Errors notifications on or off.
 *
 * Args:
 *     attr: The CCC attribute that changed.
 *     value: BT_GATT_CCC_NOTIFY if enabled, 0 if disabled.
 */
static void err_ccc_changed(const struct bt_gatt_attr *attr, uint16_t value)
{
	err_notify_enabled = (value == BT_GATT_CCC_NOTIFY);
	LOG_INF("Error notifications %s",
		err_notify_enabled ? "enabled" : "disabled");
}

/*
 * The Remote Service GATT table.
 *
 * Attribute index layout (used when sending notifications):
 *     [0] Service declaration
 *     [1] Sound level declaration   [2] Sound level value   [3] Sound CCC
 *     [4] Errors declaration        [5] Errors value        [6] Errors CCC
 *     [7] Message declaration       [8] Message value
 */
BT_GATT_SERVICE_DEFINE(remote_srv,
	BT_GATT_PRIMARY_SERVICE(BT_UUID_REMOTE_SERVICE),
	BT_GATT_CHARACTERISTIC(BT_UUID_REMOTE_SOUND,
			       BT_GATT_CHRC_READ | BT_GATT_CHRC_NOTIFY,
			       BT_GATT_PERM_READ,
			       read_sound_cb, NULL, NULL),
	BT_GATT_CCC(sound_ccc_changed, BT_GATT_PERM_READ | BT_GATT_PERM_WRITE),
	BT_GATT_CHARACTERISTIC(BT_UUID_REMOTE_ERR,
			       BT_GATT_CHRC_READ | BT_GATT_CHRC_NOTIFY,
			       BT_GATT_PERM_READ,
			       read_error_cb, NULL, NULL),
	BT_GATT_CCC(err_ccc_changed, BT_GATT_PERM_READ | BT_GATT_PERM_WRITE),
	BT_GATT_CHARACTERISTIC(BT_UUID_REMOTE_MSG,
			       BT_GATT_CHRC_WRITE_WITHOUT_RESP,
			       BT_GATT_PERM_WRITE,
			       NULL, on_write, NULL),
);

/* Attribute indexes of the values that get notified (see table above). */
#define SOUND_ATTR_IDX 2
#define ERR_ATTR_IDX   5

/*
 * Start connectable advertising.
 *
 * Runs on the system work queue. Called at startup and again after each
 * disconnect so the phone can reconnect.
 */
static void adv_work_handler(struct k_work *work)
{
	int err = bt_le_adv_start(BT_LE_ADV_CONN_FAST_1, ad, ARRAY_SIZE(ad),
				  sd, ARRAY_SIZE(sd));

	if (err) {
		LOG_ERR("Could not start advertising (%d)", err);
		return;
	}

	LOG_INF("Advertising as \"%s\"", DEVICE_NAME);
}

/*
 * Called when a phone connects.
 *
 * Args:
 *     conn: The new connection.
 *     err: 0 on success, otherwise an HCI error code.
 */
static void on_connected(struct bt_conn *conn, uint8_t err)
{
	if (err) {
		LOG_ERR("Connection error: %u", err);
		return;
	}

	LOG_INF("BT connected");
	current_conn = bt_conn_ref(conn);
}

/*
 * Called when the phone disconnects.
 *
 * Args:
 *     conn: The connection that ended.
 *     reason: HCI reason code for the disconnect.
 */
static void on_disconnected(struct bt_conn *conn, uint8_t reason)
{
	LOG_INF("BT disconnected (reason: %u)", reason);

	if (current_conn) {
		bt_conn_unref(current_conn);
		current_conn = NULL;
	}

	sound_notify_enabled = false;
	err_notify_enabled = false;
}

/*
 * Called once the old connection is fully cleaned up.
 *
 * This is the safe point to start advertising again.
 */
static void on_recycled(void)
{
	k_work_submit(&adv_work);
}

BT_CONN_CB_DEFINE(conn_callbacks) = {
	.connected = on_connected,
	.disconnected = on_disconnected,
	.recycled = on_recycled,
};

int bluetooth_init(struct bt_remote_srv_cb *remote_cb)
{
	LOG_INF("Initializing Bluetooth");

	if (remote_cb) {
		remote_service_callbacks = *remote_cb;
	}

	/* With NULL, bt_enable() waits until Bluetooth is ready. */
	int err = bt_enable(NULL);

	if (err) {
		LOG_ERR("bt_enable returned %d", err);
		return err;
	}

	k_work_init(&adv_work, adv_work_handler);
	k_work_submit(&adv_work);

	return 0;
}

int bluetooth_send_sound_level(int32_t db10, int32_t frequency_hz)
{
	sound_measurement.db10 = db10;
	sound_measurement.frequency_hz = frequency_hz;

	if (!current_conn || !sound_notify_enabled) {
		return 0;
	}

	return bt_gatt_notify(current_conn, &remote_srv.attrs[SOUND_ATTR_IDX],
			      &sound_measurement, sizeof(sound_measurement));
}

int bluetooth_set_errors(uint32_t flags)
{
	error_flags |= flags;

	if (!current_conn || !err_notify_enabled) {
		return 0;
	}

	return bt_gatt_notify(current_conn, &remote_srv.attrs[ERR_ATTR_IDX],
			      &error_flags, sizeof(error_flags));
}
```

## src/ble_lib.h
```c
// Credit: Code Skeleton taken from BME554 Class

#ifndef BLE_LIB_H
#define BLE_LIB_H

#include <zephyr/kernel.h>
#include <zephyr/bluetooth/bluetooth.h>
#include <zephyr/bluetooth/conn.h>
#include <zephyr/bluetooth/uuid.h>
#include <zephyr/bluetooth/gatt.h>

/* UUID of the Remote Service */
// Project ID: 065 (3rd entry)
// MFG ID = 0x02DF (4th entry)

#define BT_UUID_REMOTE_SERV_VAL \
	BT_UUID_128_ENCODE(0xe9ea0000, 0xe19b, 0x0065, 0x02DF, 0xc7907585fc48)
#define BT_UUID_REMOTE_SOUND_VAL \
	BT_UUID_128_ENCODE(0xe9ea0001, 0xe19b, 0x0065, 0x02DF, 0xc7907585fc48)
#define BT_UUID_REMOTE_ERR_VAL \
	BT_UUID_128_ENCODE(0xe9ea0002, 0xe19b, 0x0065, 0x02DF, 0xc7907585fc48)
#define BT_UUID_REMOTE_MSG_VAL \
	BT_UUID_128_ENCODE(0xe9ea0003, 0xe19b, 0x0065, 0x02DF, 0xc7907585fc48)

#define BT_UUID_REMOTE_SERVICE BT_UUID_DECLARE_128(BT_UUID_REMOTE_SERV_VAL)
#define BT_UUID_REMOTE_SOUND BT_UUID_DECLARE_128(BT_UUID_REMOTE_SOUND_VAL)
#define BT_UUID_REMOTE_ERR BT_UUID_DECLARE_128(BT_UUID_REMOTE_ERR_VAL)
#define BT_UUID_REMOTE_MSG BT_UUID_DECLARE_128(BT_UUID_REMOTE_MSG_VAL)

// Errr flags for BLE characteristic
enum ble_error_flags {
	ERR_ADC_INIT    = BIT(0),
	ERR_ADC_READ    = BIT(1),
	ERR_CALIBRATION = BIT(2),
};

// Notification flags for BLE characteristic
enum bt_data_notifications_enabled {
    BT_DATA_NOTIFICATIONS_ENABLED,
    BT_DATA_NOTIFICATIONS_DISABLED,
};

// Callback structure for the remote service
struct bt_remote_srv_cb {
    void (*notif_changed)(enum bt_data_notifications_enabled status);
    void (*data_rx)(struct bt_conn *conn, const uint8_t *const data, uint16_t len);
};

/* Payload sent by the sound characteristic to the display. */
struct sound_measurement {
	int32_t db10;
	int32_t frequency_hz;
};

int bluetooth_init(struct bt_remote_srv_cb *remote_cb);
int bluetooth_send_sound_level(int32_t db10, int32_t frequency_hz);
int bluetooth_set_errors(uint32_t flags);

#endif
```
